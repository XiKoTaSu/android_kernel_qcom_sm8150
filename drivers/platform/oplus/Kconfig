## drivers/platform/oplus/Kconfig
```kconfig
# OPlus configuration options

config MACH_OPLUS
	bool "OPlus device"
	depends on ARCH_QCOM
	help
	  Support for OPlus products

config MACH_OPLUS_SM7150
	bool "OPlus SM7150"
	depends on ARCH_QCOM
	select MACH_OPLUS
	help
	  Support for OPlus SM7150 devices

menu "OPlus board selection"

config MACH_OPLUS_OP4AA7
  bool "OPPO K5 board"
  select MACH_OPLUS_SM7150
  help
    Support for OPPO K5 (OP4AA7)

endmenu
```
